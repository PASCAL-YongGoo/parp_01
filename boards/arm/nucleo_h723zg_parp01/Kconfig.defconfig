## boards/arm/nucleo_h723zg_parp01/Kconfig.defconfig
```kconfig
# Copyright (c) 2025 PARP-01 Project
# SPDX-License-Identifier: Apache-2.0

if BOARD_NUCLEO_H723ZG_PARP01

config BOARD
	default "nucleo_h723zg_parp01"

config BUILD_OUTPUT_BIN
	default y

endif # BOARD_NUCLEO_H723ZG_PARP01
```

## boards/arm/nucleo_h723zg_parp01/Kconfig.nucleo_h723zg_parp01
```kconfig
# Copyright (c) 2025 PARP-01 Project
# SPDX-License-Identifier: Apache-2.0

config BOARD_NUCLEO_H723ZG_PARP01
	select SOC_STM32H723XX
```

## boards/arm/nucleo_h723zg_parp01/board.yml
```yaml
board:
  name: nucleo_h723zg_parp01
  full_name: PARP-01 Custom Board (STM32H723ZG)
  vendor: custom
  socs:
    - name: stm32h723xx
```

## boards/arm/nucleo_h723zg_parp01/nucleo_h723zg_parp01_defconfig
```kconfig
# SPDX-License-Identifier: Apache-2.0

# Enable MPU
CONFIG_ARM_MPU=y

# Enable Hardware Stack Protection
CONFIG_HW_STACK_PROTECTION=y

# Enable GPIO
CONFIG_GPIO=y

# Enable Pinctrl
CONFIG_PINCTRL=y

# Enable Clock Control
CONFIG_CLOCK_CONTROL=y

# Serial Drivers
CONFIG_SERIAL=y
CONFIG_UART_INTERRUPT_DRIVEN=y

# Console
CONFIG_CONSOLE=y
CONFIG_UART_CONSOLE=y

# Enable printf/printk
CONFIG_PRINTK=y
# CONFIG_EARLY_CONSOLE is not set (custom pins need pinctrl init first)
```
